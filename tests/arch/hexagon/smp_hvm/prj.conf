## CMakeLists.txt
```
# SPDX-License-Identifier: Apache-2.0
# Copyright (c) Qualcomm Technologies, Inc. and/or its subsidiaries.

cmake_minimum_required(VERSION 3.28.0)
find_package(Zephyr REQUIRED HINTS $ENV{ZEPHYR_BASE})
project(smp_hvm)

target_sources(app PRIVATE src/main.c)
target_sources_ifdef(CONFIG_USERSPACE app PRIVATE src/user.c)
target_include_directories(app PRIVATE ${ZEPHYR_BASE}/arch/${ARCH}/include)
```

## prj.conf
```kconfig
CONFIG_ZTEST=y
# A second HW thread for vmstart; the kernel itself stays UP.
CONFIG_MP_MAX_NUM_CPUS=2
```

## src/main.c
```c
/*
 * Copyright (c) Qualcomm Technologies, Inc. and/or its subsidiaries.
 *
 * SPDX-License-Identifier: Apache-2.0
 */

#include <zephyr/kernel.h>
#include <zephyr/ztest.h>
#include <zephyr/sys/util.h>
#include <hexagon_vm.h>

ZTEST(smp_hvm, test_vpid_boot_cpu)
{
	uint32_t id = hexagon_vm_vpid();

	TC_PRINT("boot VCPU id 0x%08x cpuidx %u\n", id, HVM_ID_CPUIDX(id));
	zassert_true(HVM_ID_CPUIDX(id) < HVM_MAX_VCPUS, "boot VCPU cpuidx %u", HVM_ID_CPUIDX(id));
	zassert_equal(hexagon_vm_vpid(), id, "vpid not stable");
}

ZTEST(smp_hvm, test_cpu_lookup)
{
	unsigned int key = arch_irq_lock();
	_cpu_t *cpu = arch_curr_cpu();
	uint32_t id = arch_proc_id();

	arch_irq_unlock(key);

	zassert_true(id < arch_num_cpus(), "CPU id %u", id);
	zassert_equal_ptr(cpu, &_kernel.cpus[id], "CPU %u has the wrong _cpu_t", id);
}

static volatile uint32_t probe_vpid;

void probe_entry_c(void)
{
	probe_vpid = hexagon_vm_vpid();
	hexagon_vm_stop(VM_STOP_NONE);
}

/* A new VCPU's FRAMELIMIT and FRAMEKEY are undefined, clear them first */
void probe_entry(void);
__asm__(".pushsection .text\n"
	".p2align 2\n"
	"probe_entry:\n"
	"	r0 = #0\n"
	"	r30 = #0\n"
	"	c16 = r0\n"
	"	c17 = r0\n"
	"	jump probe_entry_c\n"
	".popsection\n");

ZTEST(smp_hvm, test_vmstart_runs_second_vcpu)
{
	static uint64_t probe_stack[64];
	int32_t id;

	id = hexagon_vm_start(probe_entry, &probe_stack[ARRAY_SIZE(probe_stack)]);
	zassert_not_equal(id, -1, "vmstart failed");
	TC_PRINT("second VCPU id 0x%08x\n", (uint32_t)id);
	zassert_true(HVM_ID_CPUIDX((uint32_t)id) < HVM_MAX_VCPUS, "new VCPU cpuidx out of range");
	zassert_not_equal(HVM_ID_CPUIDX((uint32_t)id), HVM_ID_CPUIDX(hexagon_vm_vpid()),
			  "new VCPU has the caller's cpuidx");

	zassert_true(WAIT_FOR(probe_vpid != 0U, 1000000, k_busy_wait(10)),
		     "second VCPU did not run");
	zassert_equal(probe_vpid, (uint32_t)id, "secondary saw vpid 0x%x, vmstart returned 0x%x",
		      probe_vpid, (uint32_t)id);
}

#if defined(CONFIG_SMP) && defined(CONFIG_SCHED_CPU_MASK) && defined(CONFIG_IRQ_OFFLOAD)
#include <zephyr/irq_offload.h>

static volatile int32_t offload_cpu;

static void offload_fn(const void *arg)
{
	ARG_UNUSED(arg);
	offload_cpu = (int32_t)arch_proc_id();
}

static void offload_thread(void *p1, void *p2, void *p3)
{
	ARG_UNUSED(p2);
	ARG_UNUSED(p3);

	offload_cpu = -1;
	irq_offload(offload_fn, NULL);
	zassert_equal(offload_cpu, (int32_t)(uintptr_t)p1, "offload ran on CPU %d",
		      offload_cpu);
}

ZTEST(smp_hvm, test_irq_offload_each_cpu)
{
	static K_THREAD_STACK_DEFINE(stack, 1024);
	static struct k_thread thread;

	for (unsigned int cpu = 0U; cpu < arch_num_cpus(); cpu++) {
		k_tid_t tid = k_thread_create(&thread, stack, K_THREAD_STACK_SIZEOF(stack),
					      offload_thread, (void *)(uintptr_t)cpu, NULL, NULL,
					      K_PRIO_PREEMPT(0), 0, K_FOREVER);

		zassert_ok(k_thread_cpu_pin(tid, (int)cpu));
		k_thread_start(tid);
		zassert_ok(k_thread_join(tid, K_SECONDS(5)), "offload on CPU %u hung", cpu);
	}
}
#endif

ZTEST_SUITE(smp_hvm, NULL, NULL, NULL, NULL, NULL);
```

## src/user.c
```c
/*
 * Copyright (c) Qualcomm Technologies, Inc. and/or its subsidiaries.
 *
 * SPDX-License-Identifier: Apache-2.0
 */

#include <zephyr/kernel.h>
#include <zephyr/ztest.h>

#define STACK_SIZE 2048
#define RUN_COUNT  100000U

static uint32_t __aligned(CONFIG_MMU_PAGE_SIZE)
	shared_buf[CONFIG_MMU_PAGE_SIZE / sizeof(uint32_t)];
K_MEM_PARTITION_DEFINE(shared_part, shared_buf, sizeof(shared_buf), K_MEM_PARTITION_P_RW_U_RW);

static K_THREAD_STACK_ARRAY_DEFINE(user_stacks, 2, STACK_SIZE);
static struct k_thread user_threads[2];

/*
 * Each thread runs on its own CPU at the same time as the other, in the
 * same domain: both stacks and the partition must be mapped at once.
 */
static void user_fn(void *p1, void *p2, void *p3)
{
	uint32_t idx = (uint32_t)(uintptr_t)p1;
	volatile uint32_t *mine = &shared_buf[idx];
	volatile uint32_t *other = &shared_buf[idx ^ 1U];
	volatile uint32_t local = 0U;

	ARG_UNUSED(p2);
	ARG_UNUSED(p3);

	*mine = 1U;
	while (*other == 0U) {
	}
	while (local < RUN_COUNT) {
		local++;
		*mine = local;
	}
}

ZTEST(smp_hvm, test_user_threads_each_cpu)
{
	static struct k_mem_domain domain;
	struct k_mem_partition *parts[] = {&shared_part};

	(void)memset(shared_buf, 0, sizeof(shared_buf));
	zassert_equal(k_mem_domain_init(&domain, ARRAY_SIZE(parts), parts), 0);

	for (uint32_t i = 0U; i < 2U; i++) {
		k_tid_t tid = k_thread_create(&user_threads[i], user_stacks[i], STACK_SIZE,
					      user_fn, (void *)(uintptr_t)i, NULL, NULL,
					      K_PRIO_PREEMPT(1), K_USER, K_FOREVER);

		zassert_equal(k_mem_domain_add_thread(&domain, tid), 0);
		zassert_equal(k_thread_cpu_pin(tid, (int)i), 0);
	}
	for (uint32_t i = 0U; i < 2U; i++) {
		k_thread_start(&user_threads[i]);
	}
	for (uint32_t i = 0U; i < 2U; i++) {
		zassert_equal(k_thread_join(&user_threads[i], K_SECONDS(10)), 0,
			      "user thread %u did not finish", i);
	}

	for (uint32_t i = 0U; i < 2U; i++) {
		zassert_equal(shared_buf[i], RUN_COUNT, "thread %u count %u", i, shared_buf[i]);
	}
}
```
