## drivers/i2c/Kconfig.omap
```kconfig
config I2C_OMAP
	bool "TI OMAP I2C Driver"
	default y
	help
		Enable the I2C driver for TI OMAP SoCs.

config I2C_OMAP_BUS_RECOVERY
	bool "Bus recovery support"
	depends on I2C_OMAP
	select I2C_BITBANG
	help
		Enable OMAP I2C driver bus recovery support via bitbanging.
```

## drivers/pwm/Kconfig.ti_ehrpwm
```kconfig
# TI EHRPWM PWM configuration options

# Copyright (C) 2024 Dhruv Menon <dhruvmenon1104@gmail.com>
# SPDX-License-Identifier: Apache-2.0

config PWM_TIEHRPWM
	bool "TI TIEHRPWM PWM Driver"
	default y
	depends on DT_HAS_TI_EHRPWM_PWM_ENABLED
	select PINCTRL
	help
	  Enable TI TIEHRPWM PWM Driver.
```

## drivers/spi/Kconfig.omap
```kconfig
# Copyright (C) 2024 BeagleBoard.org Foundation
# Copyright (C) 2024 Dhruv Menon <dhruvmenon1104@gmail.com>

config SPI_OMAP
	bool "OMAP SPI driver"
	default y
	depends on DT_HAS_TI_OMAP_I2C_ENABLED
	help
	  Enable the SPI driver for TI K3 driver.
```

## dts/bindings/i2c/ti,omap-i2c.yaml
```yaml
# dts/bindings/i2c/omap-i2c.yaml

description: TI OMAP I2C Controller

compatible: "ti,omap-i2c"

include: i2c-controller.yaml

properties:
  reg:
    description: Base address and size of the I2C registers.
    required: true

  clocks:
    description: Phandles to the clock gate.

  interrupts:
    description: Interrupt specifier for the I2C controller.

  pinctrl-0:
    type: phandle
    description: Pin control groups for this I2C instance.

  pinctrl-names:
    type: string
    description: Names for the pin control groups.
```

## dts/bindings/pwm/ti,ehrpwm-pwm.yaml
```yaml
#
# Copyright (c) 2025 Dhruv Menon <dhruvmenon1104@gmail.com>
# SPDX-License-Identifier: Apache-2.0

compatible: "ti,ehrpwm-pwm"

include: [base.yaml]

properties:
  reg:
    required: true
  clocks:
    required: false
  pinctrl-0:
    required: false

pwm-cells:
  - channel
  - period
  - flags
```

## dts/bindings/spi/ti,omap-spi.yaml
```yaml
# SPDX-License-Identifier: Apache-2.0
# Description: YAML binding file for the TI OMAP SPI driver with per-CS configuration

description: |
  Binding for the SPI controller found in TI OMAP SoCs, allowing per-chip-select 
  configuration of SPI word length, frequency, and mode.

compatible: ti,omap-spi
bus: spi
include: [spi-controller.yaml, pinctrl-device.yaml, base.yaml]

properties:
  reg:
    type: array
    description: Base address and size of the SPI register set.
```

## soc/ti/k3/j7/Kconfig
```kconfig
# Copyright (c) 2023 Enphase Energy
# SPDX-License-Identifier: Apache-2.0

config SOC_J721E_R5
	select ARM
	select CPU_CORTEX_R5
	select CPU_HAS_ARM_MPU
	select ARM_CUSTOM_INTERRUPT_CONTROLLER
	select VIM
	select TI_DM_TIMER
	select OPENAMP_RSC_TABLE
	select UART_NS16550_ACCESS_WORD_ONLY if UART_NS16550

config SOC_J722S_R5_MAIN
	select ARM
	select CPU_CORTEX_R5
	select CPU_HAS_ARM_MPU
	select ARM_CUSTOM_INTERRUPT_CONTROLLER
	select VIM
	select TI_DM_TIMER
	select OPENAMP_RSC_TABLE
	select UART_NS16550_ACCESS_WORD_ONLY if UART_NS16550

config SOC_J722S_R5_MCU
	select ARM
	select CPU_CORTEX_R5
	select CPU_HAS_ARM_MPU
	select ARM_CUSTOM_INTERRUPT_CONTROLLER
	select VIM
	select TI_DM_TIMER
	select OPENAMP_RSC_TABLE
	select UART_NS16550_ACCESS_WORD_ONLY if UART_NS16550
```

## soc/ti/k3/j7/Kconfig.defconfig
```kconfig
# Copyright (C) 2023 BeagleBoard.org Foundation
# Copyright (C) 2023 S Prashanth
#
# SPDX-License-Identifier: Apache-2.0

if SOC_SERIES_J7

config NUM_IRQS
	default 512

config SYS_CLOCK_HW_CYCLES_PER_SEC
	default 19200000

config SYS_CLOCK_TICKS_PER_SEC
	default 10000

if SERIAL

config UART_NS16550
	default y

config UART_NS16550_TI_K3
	default y

choice UART_NS16550_VARIANT
	default UART_NS16550_VARIANT_NS16750
endchoice

endif # SERIAL

config PINCTRL
	default y

if !XIP

config FLASH_SIZE
	default 0

config FLASH_BASE_ADDRESS
	default 0

endif # XIP

config BUILD_OUTPUT_BIN
	default n if SOC_J721E_R5
	default n if SOC_J722S_R5_MAIN
	default n if SOC_J722S_R5_MCU

endif # SOC_SERIES_J7
```

## soc/ti/k3/j7/Kconfig.soc
```kconfig
# Copyright (C) 2023 BeagleBoard.org Foundation
# Copyright (C) 2023 S Prashanth
# Copyright (c) 2024 Texas Instruments Incorporated
# 	Andrew Davis <afd@ti.com>
#
# SPDX-License-Identifier: Apache-2.0

config SOC_SERIES_J7
	bool
	select SOC_FAMILY_TI_K3

config SOC_J721E_R5
	bool
	select SOC_SERIES_J7

config SOC_J722S_R5_MAIN
	bool
	select SOC_SERIES_J7

config SOC_J722S_R5_MCU
	bool
	select SOC_SERIES_J7

config SOC_SERIES
	default "j7" if SOC_SERIES_J7

config SOC
	default "j721e" if SOC_J721E_R5
	default "j722s" if SOC_J722S_R5_MAIN
	default "j722s" if SOC_J722S_R5_MCU

config SOC_PART_NUMBER
	default "J721e" if SOC_J721E_R5
	default "j722s" if SOC_J722S_R5_MAIN
	default "j722s" if SOC_J722S_R5_MCU
```
