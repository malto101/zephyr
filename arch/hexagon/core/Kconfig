## arch/hexagon/core/Kconfig
```kconfig
# SPDX-License-Identifier: Apache-2.0
# Copyright (c) Qualcomm Technologies, Inc. and/or its subsidiaries.

choice HEXAGON_EXECUTION_MODE
	prompt "Hexagon execution environment"
	default HEXAGON_NATIVE if SOC_LEMANS_CDSP0
	default HEXAGON_HVM_GUEST
	help
	  Select whether Hexagon runs as an H2 virtual-machine guest or directly
	  in native supervisor mode.

config HEXAGON_HVM_GUEST
	bool "H2 hypervisor guest"
	help
	  Run Zephyr as a guest under the H2 Hexagon virtual machine. This is the
	  execution mode used by the QEMU Hexagon board.

config HEXAGON_NATIVE
	bool "Native supervisor mode"
	select ARCH_HAS_SINGLE_THREAD_SUPPORT
	help
	  Run Zephyr directly on a Hexagon subsystem without the H2 hypervisor.
	  Native targets provide their own reset, interrupt, timer, and memory
	  management backends.

endchoice

config TEST_EXTRA_STACK_SIZE
	default 2048

config IDLE_STACK_SIZE
	default 1024

config PRIVILEGED_STACK_SIZE
	# Sizes thread->arch.priv_stack, the kernel-side stack each K_USER
	# thread uses for event/syscall handling (see arch_user_mode_enter()).
	# 1024 was too small for some syscalls' C call depth; 2048 covers
	# everything hit so far but is an empirical, not proven, bound.
	default 2048

config HEXAGON_MEM_DOMAIN_STACK_ENTRIES
	int "Linear-map entries per memory domain for member thread stacks"
	depends on USERSPACE
	default 16
	help
	  Each memory domain's linear list maps the stacks of all its user
	  mode threads. A page-aligned stack takes one entry, an unaligned
	  one up to a few. A user stack that does not fit faults on access.

if CPU_HAS_MMU

config HEXAGON_MMU
	bool "Hexagon MMU Support"
	select MMU
	select KERNEL_DIRECT_MAP
	select SRAM_REGION_PERMISSIONS
	help
	  Enable memory management unit support for the Hexagon architecture.
	  The HVM/H2 hypervisor maintains a single flat identity-mapped page
	  table, so mappings require virt == phys and KERNEL_DIRECT_MAP is
	  mandatory here.

endif # CPU_HAS_MMU
```

## boards/qcom/lemans_cdsp0/Kconfig.lemans_cdsp0
```kconfig
# SPDX-License-Identifier: Apache-2.0
# Copyright (c) Qualcomm Technologies, Inc. and/or its subsidiaries.

config BOARD_LEMANS_CDSP0
	default y
	select SOC_LEMANS_CDSP0
```

## boards/qcom/lemans_cdsp0/board.yml
```yaml
# SPDX-License-Identifier: Apache-2.0

board:
  name: lemans_cdsp0
  full_name: Lemans CDSP0
  vendor: qcom
  socs:
    - name: lemans_cdsp0
```

## boards/qcom/lemans_cdsp0/lemans_cdsp0_defconfig
```kconfig
# SPDX-License-Identifier: Apache-2.0
# Copyright (c) Qualcomm Technologies, Inc. and/or its subsidiaries.

CONFIG_COMPILER_RT_RTLIB=y
CONFIG_MINIMAL_LIBC=y
CONFIG_PRINTK=y
CONFIG_CONSOLE=n
CONFIG_SERIAL=n
CONFIG_UART_CONSOLE=n
CONFIG_SMP=n
CONFIG_USERSPACE=n
CONFIG_PM=n
CONFIG_SYS_CLOCK_EXISTS=n
CONFIG_MULTITHREADING=n
CONFIG_THREAD_LOCAL_STORAGE=n
CONFIG_LEMANS_SMP2P=n
CONFIG_HEXAGON_QTIMER=n
CONFIG_DCACHE=n
CONFIG_ICACHE=n
CONFIG_CACHE_MANAGEMENT=n
CONFIG_HEXAGON_MMU=n
```

## boards/qemu/hexagon/Kconfig.qemu_hexagon
```kconfig
# SPDX-License-Identifier: Apache-2.0
# Copyright (c) Qualcomm Technologies, Inc. and/or its subsidiaries.

config BOARD_QEMU_HEXAGON
	select SOC_QEMU_HEXAGON_VIRT if BOARD_QEMU_HEXAGON_QEMU_HEXAGON_VIRT
	select SOC_QEMU_HEXAGON_QCS6490_CDSP if BOARD_QEMU_HEXAGON_QEMU_HEXAGON_QCS6490_CDSP
```

## boards/qemu/hexagon/board.yml
```yaml
board:
  name: qemu_hexagon
  full_name: QEMU Emulation for Hexagon
  vendor: qemu
  socs:
    - name: qemu_hexagon_virt
    - name: qemu_hexagon_qcs6490_cdsp
    - name: qemu_hexagon_sa8775p_cdsp
```

## cmake/toolchain/host/llvm/Kconfig
```kconfig
# Copyright The Zephyr Project Contributors
# SPDX-License-Identifier: Apache-2.0

choice LLVM_LINKER
	prompt "LLVM Linker"
	default LLVM_USE_ELD if HEXAGON
	default LLVM_USE_LD

config LLVM_USE_LD
	bool "GNU ld"
	help
	  Use binutils ld linker with llvm/clang.

config LLVM_USE_LLD
	bool "LLVM lld"
	help
	  Use LLVM built-in lld linker with llvm/clang.
	  Host binutils ld does not recognise the Hexagon target
	  ("unrecognised emulation mode: cpu=hexagonvNN"), so lld and eld are
	  the only linkers in this toolchain variant that can link Hexagon.

config LLVM_USE_ELD
	bool "ELD ld.eld"
	help
	  Use the ELD linker (ld.eld) with llvm/clang.
	  Default for Hexagon: unlike lld, eld resolves an out-of-range branch
	  to an undefined weak symbol through an in-range guard stub instead
	  of relocating straight to address 0, so it does not need thunk
	  support for that case.

endchoice

config TOOLCHAIN_LLVM_SUPPORTS_THREAD_LOCAL_STORAGE
	depends on RISCV || ARM || ARM64 || HEXAGON
	def_bool y
	select TOOLCHAIN_SUPPORTS_THREAD_LOCAL_STORAGE

config TOOLCHAIN_LLVM_SUPPORTS_GNU_EXTENSIONS
	def_bool y
	select TOOLCHAIN_SUPPORTS_GNU_EXTENSIONS
```

## drivers/fpga/Kconfig.slg47910v
```kconfig
# Copyright (c) 2025 Dhruv Menon <dhruvmenon1104@gmail.com>
# SPDX-License-Identifier: Apache-2.0

config SLG47910V_FPGA
	bool "Renesas SLG47910V ForgeFPGA SPI driver"
	default y
	depends on DT_HAS_RENESAS_SLG47910V_ENABLED
	depends on SPI
	depends on GPIO
	imply CRC
	help
	  Enable support for the Renesas SLG47910V ForgeFPGA SPI configuration driver.
```

## dts/bindings/fpga/renesas,slg47910v.yaml
```yaml
# Copyright (c) 2025 Dhruv Menon <dhruvmenon1104@gmail.com>
# SPDX-License-Identifier: Apache-2.0

description: Renesas SLG47910V ForgeFPGA SPI configuration interface

compatible: "renesas,slg47910v"

include: spi-device.yaml

properties:
  pwr-gpios:
    type: phandle-array
    required: true
    description: |
      Power control GPIO pin for the FPGA.
      Example usage:
      pwr-gpios = <&gpio0 12 GPIO_ACTIVE_HIGH>;
  en-gpios:
    type: phandle-array
    required: true
    description: |
      Enable control GPIO pin for the FPGA.
      Example usage:
      en-gpios = <&gpio0 13 GPIO_ACTIVE_HIGH>;
  reset-delay-ms:
    type: int
    default: 30
    description: |
      Delay (in milliseconds) for power-off reset sequence.
      Matches shrike-ctl reference implementation. Default is 3ms.
  init-ss-low-delay-ms:
    type: int
    default: 30
    description: |
      Delay (in milliseconds) for SS low during FPGA initialization after power-on.
      Matches shrike-ctl reference implementation. Default is 3ms.
  init-ss-high-delay-us:
    type: int
    default: 30
    description: |
      Delay (in microseconds) for SS high after initialization.
      Matches shrike-ctl reference implementation. Default is 3us.
  power-on-delay-us:
    type: int
    default: 1000
    description: |
      Delay (in microseconds) between asserting PWR and EN during power-on sequence.
      Default is 1000us.
  power-off-delay-us:
    type: int
    default: 100
    description: |
      Delay (in microseconds) between deasserting EN and PWR during power-off sequence.
      Default is 100us.
  config-complete-delay-us:
    type: int
    default: 1000
    description: |
      Delay (in microseconds) after bitstream transfer to wait for configuration to complete.
      Note: SLG47910V does not have a DONE pin, so configuration completion is verified
      by timing. Default is 1000us.
```

## dts/bindings/interrupt-controller/qcom,hexagon-l2vic.yaml
```yaml
# Copyright (c) 2026 Qualcomm Technologies, Inc. and/or its subsidiaries.
# SPDX-License-Identifier: Apache-2.0

description: Qualcomm Hexagon L2 virtual interrupt controller

compatible: "qcom,hexagon-l2vic"

include: [base.yaml, interrupt-controller.yaml]

properties:
  reg:
    required: true

  interrupt-controller:
    required: true

  "#interrupt-cells":
    const: 1

interrupt-cells:
  - irq
```

## dts/bindings/timer/qcom,hexagon-qtimer.yaml
```yaml
# Copyright (c) 2026 Qualcomm Technologies, Inc. and/or its subsidiaries.
# SPDX-License-Identifier: Apache-2.0

description: Qualcomm Hexagon QTimer

compatible: "qcom,hexagon-qtimer"

include: base.yaml

properties:
  reg:
    required: true

  reg-names:
    type: string-array
    required: true
    description: Register blocks are named "ac" and "frame".

  interrupts:
    required: true

  clock-frequency:
    type: int
    required: true
```

## dts/bindings/watchdog/qcom,q6ss-watchdog.yaml
```yaml
# Copyright (c) 2026 Qualcomm Technologies, Inc. and/or its subsidiaries.
# SPDX-License-Identifier: Apache-2.0

description: Qualcomm QDSP6SS watchdog

compatible: "qcom,q6ss-watchdog"

include: base.yaml

properties:
  reg:
    required: true

  interrupts:
    required: true
```

## soc/qcom/lemans/Kconfig.defconfig
```kconfig
# SPDX-License-Identifier: Apache-2.0
# Copyright (c) Qualcomm Technologies, Inc. and/or its subsidiaries.

if SOC_LEMANS_CDSP0

config SYS_CLOCK_HW_CYCLES_PER_SEC
	default 19200000

config NUM_IRQS
	default 256

config SMP
	default n

config USERSPACE
	default n

endif # SOC_LEMANS_CDSP0
```

## soc/qcom/lemans/Kconfig.soc
```kconfig
# SPDX-License-Identifier: Apache-2.0
# Copyright (c) Qualcomm Technologies, Inc. and/or its subsidiaries.

config SOC_LEMANS_CDSP0
	bool
	select HEXAGON
	select GEN_ISR_TABLES

config SOC
	default "lemans_cdsp0" if SOC_LEMANS_CDSP0

config LEMANS_SMP2P
	bool "Lemans CDSP SMP2P lifecycle handshake"
	depends on SOC_LEMANS_CDSP0 && HEXAGON_NATIVE
	default n
	help
	  Publish the CDSP-to-APPS SMP2P lifecycle through the Lemans SMEM
	  and IPCC interfaces. Enable this only in a protocol profile after
	  the deployed SMEM ownership and Linux handshake are validated.
	  The reset/C-start profile deliberately leaves this disabled.
```

## soc/qemu/hexagon/Kconfig.defconfig
```kconfig
# SPDX-License-Identifier: Apache-2.0
# Copyright (c) Qualcomm Technologies, Inc. and/or its subsidiaries.

if SOC_QEMU_HEXAGON_VIRT

config SYS_CLOCK_HW_CYCLES_PER_SEC
	default $(dt_node_int_prop_int,/cpus/cpu@0,clock-frequency)

config NUM_IRQS
	default 64

endif # SOC_QEMU_HEXAGON_VIRT

if SOC_QEMU_HEXAGON_QCS6490_CDSP

config SYS_CLOCK_HW_CYCLES_PER_SEC
	default $(dt_node_int_prop_int,/cpus/cpu@0,clock-frequency)

config NUM_IRQS
	default 64

endif # SOC_QEMU_HEXAGON_QCS6490_CDSP

if SOC_QEMU_HEXAGON_SA8775P_CDSP

config SYS_CLOCK_HW_CYCLES_PER_SEC
	default $(dt_node_int_prop_int,/cpus/cpu@0,clock-frequency)

config NUM_IRQS
	default 64

endif # SOC_QEMU_HEXAGON_SA8775P_CDSP
```

## soc/qemu/hexagon/Kconfig.soc
```kconfig
# SPDX-License-Identifier: Apache-2.0
# Copyright (c) Qualcomm Technologies, Inc. and/or its subsidiaries.

config SOC_QEMU_HEXAGON_VIRT
	bool

config SOC_QEMU_HEXAGON_QCS6490_CDSP
	bool

config SOC_QEMU_HEXAGON_SA8775P_CDSP
	bool

config SOC
	default "qemu_hexagon_virt" if SOC_QEMU_HEXAGON_VIRT
	default "qemu_hexagon_qcs6490_cdsp" if SOC_QEMU_HEXAGON_QCS6490_CDSP
	default "qemu_hexagon_sa8775p_cdsp" if SOC_QEMU_HEXAGON_SA8775P_CDSP
```
