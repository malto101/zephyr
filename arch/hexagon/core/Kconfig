## boards/qcom/iq9075_evk/Kconfig.iq9075_evk
```kconfig
# Copyright (c) Qualcomm Technologies, Inc. and/or its subsidiaries.
# SPDX-License-Identifier: Apache-2.0

config BOARD_IQ9075_EVK
	select SOC_SA8775P_CDSP0 if BOARD_IQ9075_EVK_SA8775P_CDSP0
```

## boards/qcom/iq9075_evk/board.yml
```yaml
board:
  name: iq9075_evk
  full_name: IQ-9075 EVK
  vendor: qcom
  socs:
    - name: sa8775p
```

## boards/qemu/hexagon/qemu_hexagon_qemu_hexagon_virt_smp_defconfig
```kconfig
# SPDX-License-Identifier: Apache-2.0
# Copyright (c) Qualcomm Technologies, Inc. and/or its subsidiaries.

CONFIG_COMPILER_RT_RTLIB=y
CONFIG_BUILD_OUTPUT_BIN=y
CONFIG_PRINTK=y

# Serial console
CONFIG_SERIAL=y
CONFIG_UART_CONSOLE=y
CONFIG_CONSOLE=y
CONFIG_EARLY_CONSOLE=y

# Hexagon-specific features
CONFIG_HEXAGON_TIMER=y

# Debug and development options
CONFIG_EXCEPTION_DEBUG=y
CONFIG_HW_STACK_PROTECTION=y
CONFIG_STACK_SENTINEL=y
CONFIG_THREAD_CUSTOM_DATA=y

# One HVM VCPU per CPU. icount does not work with SMP.
CONFIG_SMP=y
CONFIG_MP_MAX_NUM_CPUS=2
CONFIG_QEMU_ICOUNT=n
```

## drivers/hwspinlock/Kconfig.qcom_tcsr_mutex
```kconfig
# Copyright (c) Qualcomm Technologies, Inc. and/or its subsidiaries.
# SPDX-License-Identifier: Apache-2.0

config HWSPINLOCK_QCOM_TCSR_MUTEX
	bool "Qualcomm TCSR mutex"
	default y
	depends on DT_HAS_QCOM_TCSR_MUTEX_ENABLED
	help
	  Hardware spinlocks in the Qualcomm TCSR mutex block, shared with
	  the other processors of the SoC.
```

## drivers/mbox/Kconfig.qcom_ipcc
```kconfig
# Copyright (c) Qualcomm Technologies, Inc. and/or its subsidiaries.
# SPDX-License-Identifier: Apache-2.0

config MBOX_QCOM_IPCC
	bool "Qualcomm IPCC mailbox"
	default y
	depends on DT_HAS_QCOM_IPCC_ENABLED
	help
	  Signalling-only mailbox on the Qualcomm Inter-Processor Communication
	  Controller, driven through this client's register frame.

config MBOX_QCOM_IPCC_RX_CHANNELS
	int "Receive callbacks per IPCC instance"
	default 4
	depends on MBOX_QCOM_IPCC
```

## dts/bindings/hwspinlock/qcom,tcsr-mutex.yaml
```yaml
# Copyright (c) Qualcomm Technologies, Inc. and/or its subsidiaries.
# SPDX-License-Identifier: Apache-2.0

description: |
  Qualcomm TCSR mutex hardware spinlocks.

  A lock is taken by writing proc-id to its register and reading it back,
  and released by writing 0.

compatible: "qcom,tcsr-mutex"

include:
  - name: base.yaml
  - name: hwspinlock-controller.yaml

properties:
  reg:
    required: true

  stride:
    type: int
    default: 0x1000
    description: Distance in bytes between two lock registers.

  proc-id:
    type: int
    required: true
    description: |
      Value this processor writes to take a lock, its SMEM host ID plus one.

hwlock-cells:
  - id
```

## dts/bindings/ipc/qcom,smem.yaml
```yaml
# Copyright (c) Qualcomm Technologies, Inc. and/or its subsidiaries.
# SPDX-License-Identifier: Apache-2.0

description: |
  Qualcomm shared memory (SMEM). The table of contents sits in the last
  4K of reg. hwlocks is the lock serializing allocations.

compatible: "qcom,smem"

include: base.yaml

properties:
  reg:
    required: true

  hwlocks:
    required: true
```

## dts/bindings/ipc/qcom,smp2p.yaml
```yaml
# Copyright (c) Qualcomm Technologies, Inc. and/or its subsidiaries.
# SPDX-License-Identifier: Apache-2.0

description: |
  Qualcomm shared memory point-to-point (SMP2P) link to one remote
  processor, over SMEM items signalled through a mailbox.

compatible: "qcom,smp2p"

include: base.yaml

properties:
  qcom,smem:
    type: array
    required: true
    description: SMEM items of the outbound and inbound states.

  qcom,local-pid:
    type: int
    required: true

  qcom,remote-pid:
    type: int
    required: true

  mboxes:
    required: true

  mbox-names:
    required: true
    description: Must be "tx".
```

## dts/bindings/mbox/qcom,ipcc.yaml
```yaml
# Copyright (c) Qualcomm Technologies, Inc. and/or its subsidiaries.
# SPDX-License-Identifier: Apache-2.0

description: |
  Qualcomm Inter-Processor Communication Controller (IPCC).

  reg is this client's register frame. The mbox specifier cell is
  IPCC_CHANNEL(client, signal), see <zephyr/dt-bindings/mailbox/qcom-ipcc.h>:
  the remote client when sending, the sender when receiving.

compatible: "qcom,ipcc"

include: [base.yaml, mailbox-controller.yaml]

properties:
  reg:
    required: true

  interrupts:
    required: true

  "#mbox-cells":
    const: 1

mbox-cells:
  - channel
```

## soc/qcom/hexagon/Kconfig
```kconfig
# Copyright (c) Qualcomm Technologies, Inc. and/or its subsidiaries.
# SPDX-License-Identifier: Apache-2.0

config SOC_FAMILY_QCOM_HEXAGON
	select HEXAGON
	select GEN_ISR_TABLES

config SOC_SA8775P_CDSP0
	select CPU_HAS_HEXAGON_HVX

config QCOM_HEXAGON_SMP2P_READY
	bool "Report boot to the remoteproc host over SMP2P"
	default y
	depends on DT_HAS_QCOM_SMP2P_ENABLED
	depends on MBOX && HWSPINLOCK
	help
	  Allocate this processor's outbound SMP2P item in SMEM and set the
	  ready and handover bits that Linux remoteproc waits for after
	  starting the DSP.
```

## soc/qcom/hexagon/Kconfig.defconfig
```kconfig
# Copyright (c) Qualcomm Technologies, Inc. and/or its subsidiaries.
# SPDX-License-Identifier: Apache-2.0

if SOC_FAMILY_QCOM_HEXAGON

config SYS_CLOCK_HW_CYCLES_PER_SEC
	default $(dt_node_int_prop_int,/cpus/cpu@0,clock-frequency)

# HVM loadlinux maps L2VIC line N to virtual IRQ 32 + N
config NUM_IRQS
	default 128

config MBOX
	default y if DT_HAS_QCOM_SMP2P_ENABLED

config HWSPINLOCK
	default y if DT_HAS_QCOM_SMP2P_ENABLED

endif # SOC_FAMILY_QCOM_HEXAGON
```

## soc/qcom/hexagon/Kconfig.soc
```kconfig
# Copyright (c) Qualcomm Technologies, Inc. and/or its subsidiaries.
# SPDX-License-Identifier: Apache-2.0

config SOC_FAMILY_QCOM_HEXAGON
	bool

config SOC_FAMILY
	default "qcom_hexagon" if SOC_FAMILY_QCOM_HEXAGON

config SOC_SA8775P
	bool
	select SOC_FAMILY_QCOM_HEXAGON

config SOC_SA8775P_CDSP0
	bool
	select SOC_SA8775P
	help
	  SA8775P (Lemans) compute DSP 0, Hexagon v73.

config SOC
	default "sa8775p" if SOC_SA8775P
```
